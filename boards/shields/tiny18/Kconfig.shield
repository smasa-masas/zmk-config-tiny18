## boards/shields/tiny18/Kconfig.shield
```kconfig
config SHIELD_TWEAKBIT_R
    def_bool $(shields_list_contains,tiny18_r)

config SHIELD_TWEAKBIT_L
    def_bool $(shields_list_contains,tiny18_l)
```
